#include <Arduino.h>
#include <M5Unified.h>

#define BUZZER_PIN 2
#define NOTE_REST 0

#define NOTE_REST 0
#define NOTE_A2 110
#define NOTE_E3 165
#define NOTE_C3 131
#define NOTE_E2 82
#define NOTE_Fs2 93
#define NOTE_Gs2 104
#define NOTE_E4 330
#define NOTE_F4 349
#define NOTE_Ds4 311
#define NOTE_A4 440
#define NOTE_C5 523
#define NOTE_D5 587
#define NOTE_D3 147
#define NOTE_B4 494
#define NOTE_B2 123
#define NOTE_Ds3 156
#define NOTE_A3 220
#define NOTE_Fs4 370
#define NOTE_Gs4 415
#define NOTE_Gs3 208
#define NOTE_E5 659
#define NOTE_A5 880
#define NOTE_C6 1047
#define NOTE_D6 1175
#define NOTE_F3 175
#define NOTE_B5 988
#define NOTE_Gs5 831
#define NOTE_F5 698
#define NOTE_Fs3 185
#define NOTE_Cs3 139
#define NOTE_D2 73
#define NOTE_Cs5 554
#define NOTE_B3 247
#define NOTE_As4 466
#define NOTE_C4 262
#define NOTE_Ds5 622
#define NOTE_Fs5 740
#define NOTE_E6 1319
#define NOTE_A6 1760
#define NOTE_B6 1976
#define NOTE_Gs6 1661
#define NOTE_F6 1397
#define NOTE_D4 294
#define NOTE_As3 233
#define NOTE_Cs4 277
#define NOTE_As5 932
#define NOTE_Cs6 1109
#define NOTE_Ds6 1245
#define NOTE_G5 784
#define NOTE_G4 392
#define NOTE_G3 196
#define NOTE_F2 87
#define NOTE_As6 1865
#define NOTE_Fs6 1480
#define NOTE_As2 117

const int tempoBPM = 160;

int melody[] = { NOTE_A2, NOTE_E3, NOTE_C3, NOTE_E2, NOTE_E3, NOTE_C3, NOTE_E2, NOTE_Fs2, NOTE_Gs2, NOTE_A2, NOTE_E3, NOTE_C3, NOTE_E2, NOTE_E3, NOTE_C3, NOTE_A2, NOTE_E4, NOTE_E4, NOTE_E3, NOTE_C3, NOTE_E4, NOTE_E4, NOTE_E2, NOTE_E4, NOTE_E4, NOTE_C3, NOTE_E3, NOTE_E4, NOTE_E4, NOTE_A2, NOTE_E4, NOTE_E4, NOTE_C3, NOTE_E3, NOTE_E4, NOTE_E4, NOTE_E2, NOTE_E4, NOTE_E4, NOTE_C3, NOTE_E3, NOTE_E4, NOTE_E4, NOTE_A2, NOTE_E4, NOTE_E4, NOTE_C3, NOTE_E3, NOTE_E4, NOTE_E4, NOTE_E2, NOTE_E4, NOTE_F4, NOTE_C3, NOTE_E3, NOTE_E4, NOTE_Ds4, NOTE_E4, NOTE_A2, NOTE_E3, NOTE_C3, NOTE_A4, NOTE_E2, NOTE_C5, NOTE_E3, NOTE_C3, NOTE_Gs2, NOTE_D5, NOTE_D5, NOTE_E3, NOTE_D3, NOTE_D5, NOTE_D5, NOTE_E2, NOTE_D5, NOTE_C5, NOTE_E3, NOTE_D3, NOTE_B4, NOTE_D5, NOTE_C5, NOTE_A2, NOTE_C5, NOTE_C5, NOTE_E3, NOTE_C3, NOTE_C5, NOTE_C5, NOTE_E2, NOTE_B4, NOTE_A4, NOTE_E3, NOTE_C3, NOTE_C5, NOTE_B2, NOTE_B4, NOTE_B4, NOTE_Ds3, NOTE_A3, NOTE_B4, NOTE_B4, NOTE_Fs2, NOTE_Fs4, NOTE_Ds3, NOTE_A3, NOTE_B4, NOTE_Gs4, NOTE_Gs3, NOTE_E3, NOTE_E2, NOTE_Fs2, NOTE_Gs2, NOTE_A2, NOTE_E4, NOTE_E4, NOTE_E3, NOTE_C3, NOTE_E4, NOTE_E4, NOTE_E2, NOTE_E4, NOTE_E4, NOTE_E3, NOTE_C3, NOTE_E4, NOTE_E4, NOTE_A2, NOTE_E4, NOTE_E4, NOTE_E3, NOTE_C3, NOTE_E4, NOTE_E4, NOTE_E2, NOTE_E4, NOTE_E4, NOTE_E3, NOTE_C3, NOTE_E4, NOTE_E4, NOTE_A2, NOTE_E4, NOTE_E4, NOTE_C3, NOTE_E3, NOTE_E4, NOTE_E4, NOTE_E2, NOTE_E4, NOTE_F4, NOTE_C3, NOTE_E3, NOTE_E4, NOTE_Ds4, NOTE_A2, NOTE_E4, NOTE_C3, NOTE_E3, NOTE_A4, NOTE_C5, NOTE_E2, NOTE_E5, NOTE_A5, NOTE_C3, NOTE_E3, NOTE_C6, NOTE_D3, NOTE_D6, NOTE_C6, NOTE_F3, NOTE_A3, NOTE_B5, NOTE_D6, NOTE_C3, NOTE_C6, NOTE_B5, NOTE_E3, NOTE_A3, NOTE_A5, NOTE_C6, NOTE_B2, NOTE_B5, NOTE_A5, NOTE_D3, NOTE_F3, NOTE_Gs5, NOTE_B5, NOTE_A2, NOTE_A5, NOTE_E5, NOTE_C5, NOTE_C3, NOTE_E3, NOTE_A4, NOTE_F5, NOTE_E2, NOTE_E5, NOTE_Fs2, NOTE_D5, NOTE_C5, NOTE_Gs2, NOTE_B4, NOTE_A4, NOTE_E2, NOTE_Gs4, NOTE_B4, NOTE_A2, NOTE_A4, NOTE_E2, NOTE_Fs2, NOTE_Gs2, NOTE_A2, NOTE_E4, NOTE_E4, NOTE_E3, NOTE_C3, NOTE_E4, NOTE_E4, NOTE_E2, NOTE_E4, NOTE_E4, NOTE_E3, NOTE_C3, NOTE_E4, NOTE_E4, NOTE_A2, NOTE_E4, NOTE_E4, NOTE_E3, NOTE_C3, NOTE_E4, NOTE_E4, NOTE_E2, NOTE_E4, NOTE_E4, NOTE_E3, NOTE_C3, NOTE_E4, NOTE_E4, NOTE_A2, NOTE_E4, NOTE_E4, NOTE_C3, NOTE_E3, NOTE_E4, NOTE_E4, NOTE_E2, NOTE_E4, NOTE_F4, NOTE_C3, NOTE_E3, NOTE_E4, NOTE_Ds4, NOTE_A2, NOTE_E4, NOTE_C3, NOTE_E3, NOTE_A4, NOTE_E2, NOTE_C5, NOTE_C3, NOTE_E3, NOTE_B2, NOTE_D5, NOTE_D5, NOTE_E3, NOTE_D3, NOTE_D5, NOTE_D5, NOTE_E2, NOTE_D5, NOTE_C5, NOTE_E3, NOTE_D3, NOTE_B4, NOTE_D5, NOTE_A2, NOTE_C5, NOTE_C5, NOTE_E3, NOTE_C3, NOTE_C5, NOTE_C5, NOTE_E2, NOTE_C5, NOTE_B4, NOTE_E3, NOTE_C3, NOTE_A4, NOTE_C5, NOTE_B2, NOTE_B4, NOTE_B4, NOTE_B4, NOTE_Ds3, NOTE_Fs3, NOTE_B4, NOTE_Fs2, NOTE_Fs4, NOTE_Ds3, NOTE_Fs3, NOTE_B4, NOTE_E3, NOTE_Gs3, NOTE_Gs4, NOTE_E2, NOTE_A2, NOTE_E4, NOTE_E4, NOTE_E3, NOTE_C3, NOTE_E4, NOTE_E4, NOTE_E2, NOTE_E4, NOTE_E4, NOTE_E3, NOTE_C3, NOTE_E4, NOTE_E4, NOTE_A2, NOTE_E4, NOTE_E4, NOTE_E3, NOTE_C3, NOTE_E4, NOTE_E4, NOTE_E2, NOTE_E4, NOTE_E4, NOTE_E3, NOTE_C3, NOTE_E4, NOTE_E4, NOTE_A2, NOTE_E4, NOTE_E4, NOTE_E3, NOTE_C3, NOTE_E4, NOTE_E4, NOTE_E2, NOTE_E4, NOTE_F4, NOTE_E3, NOTE_C3, NOTE_E4, NOTE_Ds4, NOTE_A2, NOTE_E4, NOTE_E3, NOTE_C3, NOTE_A4, NOTE_C5, NOTE_E2, NOTE_E5, NOTE_A5, NOTE_E3, NOTE_C3, NOTE_C6, NOTE_D3, NOTE_D6, NOTE_C6, NOTE_A3, NOTE_F3, NOTE_B5, NOTE_D6, NOTE_C3, NOTE_C6, NOTE_B5, NOTE_A3, NOTE_E3, NOTE_A5, NOTE_C6, NOTE_B2, NOTE_B5, NOTE_A5, NOTE_Gs3, NOTE_D3, NOTE_Gs5, NOTE_B5, NOTE_A2, NOTE_A5, NOTE_E5, NOTE_A3, NOTE_C3, NOTE_C5, NOTE_A4, NOTE_B2, NOTE_F5, NOTE_E5, NOTE_D5, NOTE_C5, NOTE_B4, NOTE_E2, NOTE_A4, NOTE_Gs4, NOTE_B4, NOTE_A4, NOTE_A2, NOTE_A2, NOTE_B2, NOTE_Cs3, NOTE_D3, NOTE_D2, NOTE_D5, NOTE_A3, NOTE_F3, NOTE_Cs5, NOTE_A2, NOTE_D5, NOTE_F3, NOTE_A3, NOTE_E5, NOTE_D3, NOTE_F5, NOTE_F3, NOTE_A3, NOTE_E5, NOTE_A2, NOTE_D5, NOTE_F3, NOTE_A3, NOTE_F5, NOTE_C3, NOTE_E5, NOTE_A3, NOTE_E3, NOTE_D5, NOTE_A2, NOTE_C5, NOTE_A3, NOTE_E3, NOTE_D5, NOTE_C3, NOTE_E5, NOTE_A3, NOTE_E3, NOTE_A2, NOTE_A3, NOTE_E3, NOTE_C5, NOTE_E3, NOTE_B4, NOTE_B3, NOTE_Gs3, NOTE_As4, NOTE_B2, NOTE_B4, NOTE_B3, NOTE_Gs3, NOTE_C5, NOTE_E3, NOTE_D5, NOTE_B3, NOTE_Gs3, NOTE_C5, NOTE_B2, NOTE_B4, NOTE_B3, NOTE_Gs3, NOTE_D5, NOTE_A2, NOTE_C5, NOTE_A2, NOTE_A4, NOTE_C3, NOTE_C5, NOTE_E3, NOTE_E5, NOTE_A3, NOTE_A5, NOTE_E3, NOTE_E5, NOTE_C3, NOTE_C5, NOTE_A2, NOTE_A4, NOTE_D3, NOTE_D5, NOTE_A3, NOTE_F3, NOTE_Cs5, NOTE_A2, NOTE_D5, NOTE_A3, NOTE_F3, NOTE_E5, NOTE_D3, NOTE_F5, NOTE_A3, NOTE_F3, NOTE_E5, NOTE_A2, NOTE_D5, NOTE_A3, NOTE_F3, NOTE_F5, NOTE_C3, NOTE_E5, NOTE_A3, NOTE_E3, NOTE_D5, NOTE_A2, NOTE_C5, NOTE_A3, NOTE_E3, NOTE_D5, NOTE_C3, NOTE_E5, NOTE_A3, NOTE_E3, NOTE_A2, NOTE_A5, NOTE_A3, NOTE_E3, NOTE_D3, NOTE_A3, NOTE_F3, NOTE_D5, NOTE_B2, NOTE_A3, NOTE_F3, NOTE_F5, NOTE_E3, NOTE_E5, NOTE_C3, NOTE_C5, NOTE_D3, NOTE_D5, NOTE_B2, NOTE_B4, NOTE_A2, NOTE_A4, NOTE_E2, NOTE_E4, NOTE_Gs4, NOTE_E5, NOTE_E3, NOTE_A2, NOTE_A4, NOTE_C5, NOTE_A5, NOTE_A3, NOTE_E2, NOTE_Fs2, NOTE_Gs2, NOTE_A2, NOTE_E4, NOTE_E4, NOTE_E3, NOTE_C3, NOTE_E4, NOTE_E4, NOTE_E2, NOTE_E4, NOTE_E4, NOTE_E3, NOTE_C3, NOTE_E4, NOTE_E4, NOTE_A2, NOTE_E4, NOTE_E4, NOTE_E3, NOTE_C3, NOTE_E4, NOTE_E4, NOTE_E2, NOTE_E4, NOTE_E4, NOTE_E3, NOTE_C3, NOTE_E4, NOTE_E4, NOTE_A2, NOTE_E4, NOTE_E4, NOTE_E3, NOTE_C3, NOTE_E4, NOTE_E4, NOTE_E2, NOTE_E4, NOTE_F4, NOTE_E3, NOTE_C3, NOTE_E4, NOTE_Ds4, NOTE_A2, NOTE_E4, NOTE_E3, NOTE_C3, NOTE_A4, NOTE_E2, NOTE_C5, NOTE_E3, NOTE_C3, NOTE_B2, NOTE_D5, NOTE_D5, NOTE_E3, NOTE_D3, NOTE_D5, NOTE_D5, NOTE_E2, NOTE_D5, NOTE_C5, NOTE_E3, NOTE_D3, NOTE_B4, NOTE_D5, NOTE_A2, NOTE_C5, NOTE_C5, NOTE_E3, NOTE_C3, NOTE_C5, NOTE_C5, NOTE_E2, NOTE_C5, NOTE_B4, NOTE_E3, NOTE_C3, NOTE_A4, NOTE_C5, NOTE_B2, NOTE_B4, NOTE_B4, NOTE_Ds3, NOTE_Fs3, NOTE_B4, NOTE_B4, NOTE_Fs2, NOTE_Fs4, NOTE_Ds3, NOTE_Fs3, NOTE_B4, NOTE_E3, NOTE_Gs3, NOTE_Gs4, NOTE_E2, NOTE_A2, NOTE_E4, NOTE_E4, NOTE_C3, NOTE_E3, NOTE_E4, NOTE_E4, NOTE_E2, NOTE_E4, NOTE_E4, NOTE_C3, NOTE_E3, NOTE_E4, NOTE_E4, NOTE_A2, NOTE_E4, NOTE_E4, NOTE_C3, NOTE_E3, NOTE_E4, NOTE_E4, NOTE_E2, NOTE_E4, NOTE_E4, NOTE_C3, NOTE_E3, NOTE_E4, NOTE_E4, NOTE_A2, NOTE_E4, NOTE_F4, NOTE_C3, NOTE_E3, NOTE_E4, NOTE_Ds4, NOTE_E2, NOTE_E4, NOTE_C3, NOTE_E3, NOTE_A4, NOTE_C5, NOTE_A2, NOTE_E5, NOTE_C3, NOTE_E3, NOTE_A5, NOTE_E2, NOTE_C6, NOTE_C3, NOTE_E3, NOTE_D3, NOTE_D6, NOTE_C6, NOTE_F3, NOTE_A3, NOTE_B5, NOTE_D6, NOTE_C3, NOTE_C6, NOTE_B5, NOTE_E3, NOTE_A3, NOTE_A5, NOTE_C6, NOTE_B2, NOTE_B5, NOTE_A5, NOTE_D3, NOTE_Gs3, NOTE_Gs5, NOTE_B5, NOTE_A2, NOTE_A5, NOTE_E5, NOTE_C3, NOTE_A3, NOTE_C5, NOTE_A4, NOTE_B2, NOTE_F5, NOTE_E5, NOTE_D5, NOTE_C5, NOTE_B4, NOTE_E2, NOTE_A4, NOTE_Gs4, NOTE_B4, NOTE_A4, NOTE_A2, NOTE_A2, NOTE_C3, NOTE_E3, NOTE_E2, NOTE_C3, NOTE_E3, NOTE_E2, NOTE_Fs2, NOTE_Gs2, NOTE_A2, NOTE_C3, NOTE_E3, NOTE_E2, NOTE_C3, NOTE_E3, NOTE_A2, NOTE_C3, NOTE_E3, NOTE_A3, NOTE_E2, NOTE_C3, NOTE_E3, NOTE_A3, NOTE_E2, NOTE_Fs2, NOTE_Gs2, NOTE_A2, NOTE_C3, NOTE_E3, NOTE_A3, NOTE_E2, NOTE_C3, NOTE_E3, NOTE_A3, NOTE_A2, NOTE_E3, NOTE_A3, NOTE_C4, NOTE_E2, NOTE_E3, NOTE_A3, NOTE_C4, NOTE_A2, NOTE_A3, NOTE_C4, NOTE_E4, NOTE_E2, NOTE_A3, NOTE_C4, NOTE_E4, NOTE_A2, NOTE_C4, NOTE_E4, NOTE_A4, NOTE_E2, NOTE_E4, NOTE_A4, NOTE_C5, NOTE_A2, NOTE_A4, NOTE_C5, NOTE_E5, NOTE_E2, NOTE_C5, NOTE_E5, NOTE_A5, NOTE_A2, NOTE_E5, NOTE_C5, NOTE_A4, NOTE_E3, NOTE_C3, NOTE_E5, NOTE_C5, NOTE_A4, NOTE_E2, NOTE_E5, NOTE_C5, NOTE_A4, NOTE_C3, NOTE_E3, NOTE_E5, NOTE_C5, NOTE_A4, NOTE_A2, NOTE_E5, NOTE_C5, NOTE_A4, NOTE_C3, NOTE_E3, NOTE_E5, NOTE_C5, NOTE_A4, NOTE_E2, NOTE_E5, NOTE_C5, NOTE_A4, NOTE_C3, NOTE_E3, NOTE_E5, NOTE_C5, NOTE_A4, NOTE_A2, NOTE_E5, NOTE_C5, NOTE_A4, NOTE_C3, NOTE_E3, NOTE_E5, NOTE_C5, NOTE_A4, NOTE_E2, NOTE_E5, NOTE_F5, NOTE_C3, NOTE_E3, NOTE_E5, NOTE_Ds5, NOTE_A2, NOTE_E5, NOTE_C3, NOTE_E3, NOTE_A5, NOTE_E2, NOTE_C6, NOTE_C3, NOTE_E3, NOTE_B2, NOTE_E5, NOTE_Gs5, NOTE_D6, NOTE_E3, NOTE_D3, NOTE_E5, NOTE_Gs5, NOTE_D6, NOTE_E2, NOTE_E5, NOTE_Gs5, NOTE_D6, NOTE_E3, NOTE_D3, NOTE_E5, NOTE_Gs5, NOTE_D6, NOTE_A2, NOTE_E5, NOTE_A5, NOTE_C6, NOTE_E3, NOTE_C3, NOTE_E5, NOTE_A5, NOTE_C6, NOTE_E2, NOTE_E5, NOTE_A5, NOTE_C6, NOTE_E3, NOTE_C3, NOTE_E5, NOTE_A5, NOTE_C6, NOTE_B2, NOTE_Ds5, NOTE_Fs5, NOTE_B5, NOTE_Ds3, NOTE_Fs3, NOTE_Ds5, NOTE_Fs5, NOTE_B5, NOTE_Fs2, NOTE_Fs5, NOTE_Ds3, NOTE_Fs3, NOTE_B5, NOTE_E3, NOTE_Gs3, NOTE_E5, NOTE_Gs5, NOTE_E2, NOTE_A2, NOTE_E5, NOTE_C5, NOTE_A4, NOTE_C3, NOTE_E3, NOTE_E5, NOTE_C5, NOTE_A4, NOTE_E2, NOTE_E5, NOTE_C5, NOTE_A4, NOTE_C3, NOTE_E3, NOTE_E5, NOTE_C5, NOTE_A4, NOTE_A2, NOTE_E5, NOTE_C5, NOTE_A4, NOTE_C3, NOTE_E3, NOTE_E5, NOTE_C5, NOTE_A4, NOTE_E2, NOTE_E5, NOTE_C5, NOTE_A4, NOTE_C3, NOTE_E3, NOTE_E5, NOTE_C5, NOTE_A4, NOTE_A2, NOTE_E5, NOTE_F5, NOTE_C3, NOTE_E3, NOTE_E5, NOTE_Ds5, NOTE_E2, NOTE_E5, NOTE_C3, NOTE_E3, NOTE_A5, NOTE_C6, NOTE_A2, NOTE_E6, NOTE_C3, NOTE_E3, NOTE_A6, NOTE_E2, NOTE_C6, NOTE_C3, NOTE_E3, NOTE_D3, NOTE_D6, NOTE_C6, NOTE_F3, NOTE_A3, NOTE_B6, NOTE_D6, NOTE_C3, NOTE_C6, NOTE_B6, NOTE_E3, NOTE_A3, NOTE_A6, NOTE_C6, NOTE_B2, NOTE_B6, NOTE_A6, NOTE_D3, NOTE_Gs3, NOTE_Gs6, NOTE_B6, NOTE_A2, NOTE_A6, NOTE_E6, NOTE_C3, NOTE_A3, NOTE_C6, NOTE_A5, NOTE_B2, NOTE_F6, NOTE_E6, NOTE_D6, NOTE_C6, NOTE_B5, NOTE_E2, NOTE_A5, NOTE_Gs5, NOTE_B5, NOTE_A5, NOTE_A2, NOTE_E2, NOTE_D4, NOTE_D5, NOTE_F4, NOTE_A4, NOTE_Cs5, NOTE_D5, NOTE_F4, NOTE_A4, NOTE_E5, NOTE_F5, NOTE_F4, NOTE_A4, NOTE_E5, NOTE_D4, NOTE_D5, NOTE_F4, NOTE_A4, NOTE_F5, NOTE_A3, NOTE_E5, NOTE_C4, NOTE_A4, NOTE_D5, NOTE_C5, NOTE_C4, NOTE_A4, NOTE_D5, NOTE_E5, NOTE_C4, NOTE_A4, NOTE_A3, NOTE_C4, NOTE_A4, NOTE_C5, NOTE_Gs3, NOTE_B4, NOTE_B3, NOTE_E4, NOTE_As4, NOTE_B4, NOTE_B3, NOTE_E4, NOTE_C5, NOTE_D5, NOTE_B3, NOTE_E4, NOTE_C5, NOTE_Gs3, NOTE_B4, NOTE_B3, NOTE_E4, NOTE_D5, NOTE_A3, NOTE_C5, NOTE_A3, NOTE_A4, NOTE_C4, NOTE_C5, NOTE_E4, NOTE_E5, NOTE_A4, NOTE_A3, NOTE_A5, NOTE_E4, NOTE_E3, NOTE_E5, NOTE_C4, NOTE_C3, NOTE_C5, NOTE_A3, NOTE_A2, NOTE_A4, NOTE_D3, NOTE_D5, NOTE_F3, NOTE_A3, NOTE_Cs5, NOTE_A2, NOTE_D5, NOTE_F3, NOTE_A3, NOTE_E5, NOTE_D3, NOTE_F5, NOTE_F3, NOTE_A3, NOTE_E5, NOTE_A2, NOTE_D5, NOTE_F3, NOTE_A3, NOTE_F5, NOTE_C3, NOTE_E5, NOTE_E3, NOTE_A3, NOTE_D5, NOTE_A2, NOTE_C5, NOTE_E3, NOTE_A3, NOTE_D5, NOTE_C3, NOTE_E5, NOTE_E3, NOTE_A3, NOTE_A2, NOTE_A5, NOTE_E3, NOTE_A3, NOTE_D3, NOTE_F3, NOTE_A3, NOTE_D5, NOTE_B2, NOTE_F3, NOTE_A3, NOTE_F5, NOTE_E3, NOTE_E5, NOTE_C3, NOTE_C5, NOTE_D3, NOTE_D5, NOTE_B2, NOTE_B4, NOTE_A2, NOTE_A4, NOTE_Gs4, NOTE_E4, NOTE_E5, NOTE_E3, NOTE_E2, NOTE_A2, NOTE_A3, NOTE_A4, NOTE_A5, NOTE_C5, NOTE_E3, NOTE_E2, NOTE_A3, NOTE_E5, NOTE_C5, NOTE_A4, NOTE_C4, NOTE_E4, NOTE_E5, NOTE_C5, NOTE_A4, NOTE_E3, NOTE_E5, NOTE_C5, NOTE_A4, NOTE_C4, NOTE_E4, NOTE_E5, NOTE_C5, NOTE_A4, NOTE_A3, NOTE_E5, NOTE_C5, NOTE_A4, NOTE_C4, NOTE_E4, NOTE_E5, NOTE_C5, NOTE_A4, NOTE_E3, NOTE_E5, NOTE_C5, NOTE_A4, NOTE_C4, NOTE_E4, NOTE_E5, NOTE_C5, NOTE_A4, NOTE_A3, NOTE_E5, NOTE_C5, NOTE_A4, NOTE_C4, NOTE_E4, NOTE_E5, NOTE_C5, NOTE_A4, NOTE_E3, NOTE_E5, NOTE_F5, NOTE_C4, NOTE_E4, NOTE_E5, NOTE_Ds5, NOTE_A3, NOTE_E5, NOTE_C4, NOTE_E4, NOTE_A5, NOTE_E3, NOTE_C6, NOTE_C4, NOTE_E4, NOTE_B3, NOTE_Gs5, NOTE_E5, NOTE_D6, NOTE_D4, NOTE_E4, NOTE_Gs5, NOTE_E5, NOTE_D6, NOTE_E3, NOTE_Gs5, NOTE_E5, NOTE_D6, NOTE_D4, NOTE_E4, NOTE_Gs5, NOTE_E5, NOTE_D6, NOTE_A3, NOTE_E5, NOTE_A5, NOTE_C6, NOTE_C4, NOTE_E4, NOTE_E5, NOTE_A5, NOTE_C6, NOTE_E3, NOTE_E5, NOTE_A5, NOTE_C6, NOTE_C4, NOTE_E4, NOTE_E5, NOTE_A5, NOTE_C6, NOTE_B3, NOTE_Ds5, NOTE_Fs5, NOTE_B5, NOTE_Ds4, NOTE_Fs4, NOTE_Ds5, NOTE_Fs5, NOTE_B5, NOTE_Fs3, NOTE_Fs5, NOTE_Ds4, NOTE_Fs4, NOTE_B5, NOTE_E4, NOTE_E3, NOTE_Gs5, NOTE_E5, NOTE_E3, NOTE_E2, NOTE_A3, NOTE_E5, NOTE_C5, NOTE_A4, NOTE_C4, NOTE_E4, NOTE_E5, NOTE_C5, NOTE_A4, NOTE_E3, NOTE_E5, NOTE_C5, NOTE_A4, NOTE_C4, NOTE_E4, NOTE_E5, NOTE_C5, NOTE_A4, NOTE_A3, NOTE_E5, NOTE_C5, NOTE_A4, NOTE_C4, NOTE_E4, NOTE_E5, NOTE_C5, NOTE_A4, NOTE_E3, NOTE_E5, NOTE_C5, NOTE_A4, NOTE_C4, NOTE_E4, NOTE_E5, NOTE_C5, NOTE_A4, NOTE_A3, NOTE_E5, NOTE_F5, NOTE_C4, NOTE_E4, NOTE_E5, NOTE_Ds5, NOTE_E3, NOTE_E5, NOTE_C4, NOTE_E4, NOTE_A5, NOTE_C6, NOTE_A3, NOTE_E6, NOTE_C4, NOTE_E4, NOTE_A6, NOTE_E3, NOTE_C6, NOTE_C4, NOTE_E4, NOTE_D4, NOTE_F4, NOTE_D6, NOTE_C6, NOTE_A4, NOTE_B6, NOTE_D6, NOTE_C4, NOTE_E4, NOTE_C6, NOTE_B6, NOTE_A4, NOTE_A6, NOTE_C6, NOTE_B3, NOTE_D4, NOTE_B6, NOTE_A6, NOTE_E4, NOTE_Gs6, NOTE_B6, NOTE_A3, NOTE_C4, NOTE_A6, NOTE_E6, NOTE_E4, NOTE_C6, NOTE_A5, NOTE_Gs3, NOTE_E4, NOTE_F6, NOTE_E6, NOTE_D6, NOTE_C6, NOTE_E3, NOTE_E2, NOTE_B5, NOTE_A5, NOTE_Gs5, NOTE_B5, NOTE_A3, NOTE_A2, NOTE_A5, NOTE_E3, NOTE_E2, NOTE_As3, NOTE_F5, NOTE_As4, NOTE_Cs5, NOTE_Cs4, NOTE_F4, NOTE_F5, NOTE_As4, NOTE_Cs5, NOTE_F3, NOTE_F5, NOTE_As4, NOTE_Cs5, NOTE_Cs4, NOTE_F4, NOTE_F5, NOTE_As4, NOTE_Cs5, NOTE_As3, NOTE_F5, NOTE_As4, NOTE_Cs5, NOTE_Cs4, NOTE_F4, NOTE_F5, NOTE_As4, NOTE_Cs5, NOTE_F3, NOTE_F5, NOTE_As4, NOTE_Cs5, NOTE_Cs4, NOTE_F4, NOTE_F5, NOTE_As4, NOTE_Cs5, NOTE_As3, NOTE_F5, NOTE_As4, NOTE_Cs5, NOTE_Cs4, NOTE_F4, NOTE_F5, NOTE_As4, NOTE_Cs5, NOTE_F3, NOTE_F5, NOTE_Fs5, NOTE_Cs4, NOTE_F4, NOTE_F5, NOTE_E5, NOTE_As3, NOTE_F5, NOTE_Cs4, NOTE_F4, NOTE_As5, NOTE_F3, NOTE_Cs6, NOTE_Cs4, NOTE_F4, NOTE_C4, NOTE_F5, NOTE_A5, NOTE_Ds6, NOTE_Ds4, NOTE_F4, NOTE_F5, NOTE_A5, NOTE_Ds6, NOTE_F3, NOTE_F5, NOTE_A5, NOTE_Ds6, NOTE_Ds4, NOTE_F4, NOTE_F5, NOTE_A5, NOTE_Ds6, NOTE_As3, NOTE_F5, NOTE_As5, NOTE_Cs6, NOTE_Cs4, NOTE_F4, NOTE_F5, NOTE_As5, NOTE_Cs6, NOTE_F3, NOTE_F5, NOTE_As5, NOTE_Cs6, NOTE_Cs4, NOTE_F4, NOTE_F5, NOTE_As5, NOTE_Cs6, NOTE_E5, NOTE_C4, NOTE_G5, NOTE_C6, NOTE_E5, NOTE_E4, NOTE_G4, NOTE_G5, NOTE_C6, NOTE_G3, NOTE_G5, NOTE_E4, NOTE_G4, NOTE_C6, NOTE_F3, NOTE_F4, NOTE_A5, NOTE_F5, NOTE_F3, NOTE_F2, NOTE_As3, NOTE_F5, NOTE_Cs5, NOTE_As4, NOTE_Cs4, NOTE_F4, NOTE_F5, NOTE_Cs5, NOTE_As4, NOTE_F3, NOTE_F5, NOTE_Cs5, NOTE_As4, NOTE_Cs4, NOTE_F4, NOTE_F5, NOTE_Cs5, NOTE_As4, NOTE_As3, NOTE_F5, NOTE_Cs5, NOTE_As4, NOTE_Cs4, NOTE_F4, NOTE_F5, NOTE_Cs5, NOTE_As4, NOTE_F3, NOTE_F5, NOTE_Cs5, NOTE_As4, NOTE_Cs4, NOTE_F4, NOTE_F5, NOTE_Cs5, NOTE_As4, NOTE_As3, NOTE_F5, NOTE_Fs5, NOTE_Cs4, NOTE_F4, NOTE_F5, NOTE_E5, NOTE_F3, NOTE_F5, NOTE_Cs4, NOTE_F4, NOTE_As5, NOTE_Cs6, NOTE_As3, NOTE_F6, NOTE_Cs4, NOTE_F4, NOTE_As6, NOTE_F3, NOTE_Cs6, NOTE_Cs4, NOTE_F4, NOTE_Ds4, NOTE_F4, NOTE_Ds6, NOTE_Cs6, NOTE_As4, NOTE_C6, NOTE_Ds6, NOTE_Cs4, NOTE_F4, NOTE_Cs6, NOTE_C6, NOTE_As4, NOTE_As6, NOTE_Cs6, NOTE_C4, NOTE_Ds4, NOTE_C6, NOTE_As6, NOTE_F4, NOTE_A6, NOTE_C6, NOTE_As3, NOTE_Cs4, NOTE_As6, NOTE_F6, NOTE_F4, NOTE_Cs6, NOTE_As5, NOTE_A3, NOTE_F4, NOTE_Fs6, NOTE_F6, NOTE_Ds6, NOTE_Cs6, NOTE_F2, NOTE_F3, NOTE_C6, NOTE_As5, NOTE_A5, NOTE_C6, NOTE_As2, NOTE_As3, NOTE_As5, NOTE_As2, NOTE_As3, NOTE_Ds4, NOTE_Fs4, NOTE_Ds6, NOTE_Cs6, NOTE_C6, NOTE_Ds6, NOTE_Cs4, NOTE_F4, NOTE_Cs6, NOTE_C6, NOTE_As6, NOTE_Cs6, NOTE_C4, NOTE_Ds4, NOTE_C6, NOTE_As6, NOTE_A6, NOTE_C6, NOTE_As3, NOTE_Cs4, NOTE_As6, NOTE_F6, NOTE_Cs6, NOTE_As5, NOTE_A3, NOTE_C4, NOTE_Fs6, NOTE_F6, NOTE_Ds6, NOTE_Cs6, NOTE_F2, NOTE_F3, NOTE_C6, NOTE_As5, NOTE_A5, NOTE_C6, NOTE_As2, NOTE_As3, NOTE_As5, NOTE_As2, NOTE_Ds6, NOTE_As6, NOTE_As6 };
int durationsMs[] = { 750, 94, 94, 94, 94, 94, 47, 47, 47, 750, 94, 94, 94,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 469, 469 };

bool playing = false;
bool paused = false;
bool stopped = false;
size_t currentNote = 0;
unsigned long noteStartTime = 0;
int buzzerVolume = 255;
int noteDuration = 0;

void startNote(size_t i) {
  int freq = melody[i];
  noteDuration = durationsMs[i];
  if (noteDuration > 2000) noteDuration = 2000;
  if (freq == NOTE_REST) {
    ledcWriteTone(BUZZER_PIN, 0);
  } else {
    ledcWriteTone(BUZZER_PIN, freq);
    ledcWrite(BUZZER_PIN, buzzerVolume);
  }
  noteStartTime = millis();
}

void stopNote() {
  ledcWriteTone(BUZZER_PIN, 0);
}

void setup() {
  auto cfg = M5.config();
  M5.begin(cfg);

  ledcAttach(BUZZER_PIN, 2000, 8);

  M5.Display.clear();
  M5.Display.setTextDatum(middle_center);
  M5.Display.setTextSize(5);
  M5.Display.drawString("Midi", M5.Display.width()/2, M5.Display.height()/2 - 10);
  M5.Display.setTextSize(1);
  M5.Display.drawString("Press BtnA", M5.Display.width()/2, M5.Display.height()-18);
}

void loop() {
  M5.update();

 
  if (!playing && M5.BtnA.wasPressed()) {
    playing = true;
    paused = false;
    stopped = false;
    currentNote = 0;
    M5.Display.clear();
    M5.Display.setTextSize(3);
    M5.Display.drawString("Playing...", M5.Display.width()/2, M5.Display.height()/2);
    startNote(currentNote);
  }
  
  if (playing && M5.BtnB.wasPressed()) {
    paused = !paused;
    if (paused) {
      stopNote();
      M5.Display.clear();
      M5.Display.setTextSize(2);
      M5.Display.drawString("Paused", M5.Display.width()/2, M5.Display.height()/2);
    } else {
      noteStartTime = millis();
      M5.Display.clear();
      M5.Display.setTextSize(2);
      M5.Display.drawString("Resumed", M5.Display.width()/2, M5.Display.height()/2);
    }
    delay(300);
  }

  if (playing && M5.BtnC.wasPressed()) {
    stopped = true;
    playing = false;
    paused = false;
    stopNote();
    M5.Display.clear();
    M5.Display.setTextSize(2);
    M5.Display.drawString("Stopped", M5.Display.width()/2, M5.Display.height()/2);
    delay(500);
  }

  if (playing && !paused && !stopped) {
    if (millis() - noteStartTime >= noteDuration + 20) {
      stopNote();
      currentNote++;
      if (currentNote >= sizeof(melody)/sizeof(melody[0])) {
        playing = false;
        M5.Display.clear();
        M5.Display.setTextSize(2);
        M5.Display.drawString("Done", M5.Display.width()/2, M5.Display.height()/2);
      } else {
        startNote(currentNote);
      }
    }
  }
}
