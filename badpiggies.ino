#include <Arduino.h>
#include <M5Unified.h>

#define BUZZER_PIN 2
#define NOTE_REST 0
#define NOTE_C3 131
#define NOTE_C5 523
#define NOTE_G3 196
#define NOTE_G2 98
#define NOTE_As4 466
#define NOTE_Gs4 415
#define NOTE_G4 392
#define NOTE_Ds3 156
#define NOTE_F4 349
#define NOTE_As2 117
#define NOTE_Ds4 311
#define NOTE_F3 175
#define NOTE_F2 87
#define NOTE_Gs2 104
#define NOTE_C4 262
#define NOTE_D3 147
#define NOTE_D4 294
#define NOTE_Ds2 78
#define NOTE_As3 233
#define NOTE_Gs3 208
#define NOTE_As1 58
#define NOTE_D2 73
#define NOTE_C6 1047
#define NOTE_As5 932
#define NOTE_Gs5 831
#define NOTE_G5 784
#define NOTE_F5 698
#define NOTE_Ds5 622
#define NOTE_D5 587
#define NOTE_D6 1175
#define NOTE_Ds6 1245
#define NOTE_F6 1397

const int tempoBPM = 155; // tempo from MIDI

int melody[] = { NOTE_C3, NOTE_C5, NOTE_G3, NOTE_G2, NOTE_C5, NOTE_G3, NOTE_As4, NOTE_C3, NOTE_C5, NOTE_G3, NOTE_As4, NOTE_G2, NOTE_Gs4, NOTE_G3, NOTE_G4, NOTE_Ds3, NOTE_As4, NOTE_Gs4, NOTE_G3, NOTE_G4, NOTE_F4, NOTE_As2, NOTE_Ds4, NOTE_G3, NOTE_F4, NOTE_Ds3, NOTE_G4, NOTE_G3, NOTE_As2, NOTE_G3, NOTE_As2, NOTE_As4, NOTE_F3, NOTE_F2, NOTE_As4, NOTE_F3, NOTE_Gs4, NOTE_As2, NOTE_G4, NOTE_F3, NOTE_F4, NOTE_F2, NOTE_Ds4, NOTE_F3, NOTE_F4, NOTE_Gs2, NOTE_G4, NOTE_Ds4, NOTE_Ds3, NOTE_C4, NOTE_Ds4, NOTE_F2, NOTE_G4, NOTE_Ds3, NOTE_F4, NOTE_G2, NOTE_Ds4, NOTE_D3, NOTE_D4, NOTE_G2, NOTE_D4, NOTE_D3, NOTE_As4, NOTE_C3, NOTE_C5, NOTE_G3, NOTE_G2, NOTE_C5, NOTE_G3, NOTE_As4, NOTE_C3, NOTE_C5, NOTE_G3, NOTE_As4, NOTE_G2, NOTE_Gs4, NOTE_G3, NOTE_G4, NOTE_Ds3, NOTE_As4, NOTE_Gs4, NOTE_G3, NOTE_G4, NOTE_F4, NOTE_As2, NOTE_Ds4, NOTE_G3, NOTE_F4, NOTE_Ds3, NOTE_G4, NOTE_G3, NOTE_As2, NOTE_G3, NOTE_Gs4, NOTE_As2, NOTE_As4, NOTE_F3, NOTE_F2, NOTE_As4, NOTE_F3, NOTE_Gs4, NOTE_As2, NOTE_G4, NOTE_F3, NOTE_F4, NOTE_F2, NOTE_Ds4, NOTE_F3, NOTE_F4, NOTE_Gs2, NOTE_G4, NOTE_Ds4, NOTE_Ds3, NOTE_C4, NOTE_Ds4, NOTE_F2, NOTE_G4, NOTE_Ds3, NOTE_F4, NOTE_G2, NOTE_Ds4, NOTE_D3, NOTE_D4, NOTE_G2, NOTE_D4, NOTE_D3, NOTE_Gs2, NOTE_Ds3, NOTE_C4, NOTE_D4, NOTE_Ds2, NOTE_Ds4, NOTE_Ds3, NOTE_C4, NOTE_Gs2, NOTE_F4, NOTE_Ds3, NOTE_Ds4, NOTE_Ds2, NOTE_D4, NOTE_Ds3, NOTE_C4, NOTE_As2, NOTE_As3, NOTE_F3, NOTE_Gs3, NOTE_F2, NOTE_G3, NOTE_F3, NOTE_Gs3, NOTE_As2, NOTE_As3, NOTE_F3, NOTE_F2, NOTE_F3, NOTE_F3, NOTE_Ds2, NOTE_D3, NOTE_Ds3, NOTE_As1, NOTE_F3, NOTE_D3, NOTE_G3, NOTE_G3, NOTE_Ds2, NOTE_F3, NOTE_As1, NOTE_Ds3, NOTE_D3, NOTE_Ds2, NOTE_Ds3, NOTE_As1, NOTE_Ds3, NOTE_D2, NOTE_D3, NOTE_D2, NOTE_C4, NOTE_D4, NOTE_Gs2, NOTE_Ds4, NOTE_Ds3, NOTE_C4, NOTE_D4, NOTE_Ds2, NOTE_Ds4, NOTE_Ds3, NOTE_C4, NOTE_Gs2, NOTE_F4, NOTE_Ds3, NOTE_Ds4, NOTE_Ds2, NOTE_D4, NOTE_Ds3, NOTE_C4, NOTE_As2, NOTE_As3, NOTE_Gs3, NOTE_G3, NOTE_F3, NOTE_Gs3, NOTE_As3, NOTE_F2, NOTE_F3, NOTE_Gs3, NOTE_G3, NOTE_As2, NOTE_F3, NOTE_Ds3, NOTE_F2, NOTE_F3, NOTE_D2, NOTE_D3, NOTE_Ds3, NOTE_D2, NOTE_F3, NOTE_D3, NOTE_D2, NOTE_G3, NOTE_D3, NOTE_F3, NOTE_D2, NOTE_Ds3, NOTE_D3, NOTE_D3, NOTE_G2, NOTE_D3, NOTE_Ds3, NOTE_D3, NOTE_G2, NOTE_D3, NOTE_Ds3, NOTE_D3, NOTE_G2, NOTE_D3, NOTE_Ds3, NOTE_D3, NOTE_G2, NOTE_D3, NOTE_Ds3, NOTE_D3, NOTE_Ds3, NOTE_D3, NOTE_G2, NOTE_Ds3, NOTE_D3, NOTE_Ds3, NOTE_D3, NOTE_G2, NOTE_Ds3, NOTE_D3, NOTE_Ds3, NOTE_D3, NOTE_G2, NOTE_Ds3, NOTE_D3, NOTE_Ds3, NOTE_D3, NOTE_G2, NOTE_Ds3, NOTE_G3, NOTE_G2, NOTE_Gs3, NOTE_G3, NOTE_G2, NOTE_Gs3, NOTE_G3, NOTE_G2, NOTE_Gs3, NOTE_G3, NOTE_G2, NOTE_Gs3, NOTE_G3, NOTE_G2, NOTE_Gs3, NOTE_G3, NOTE_G2, NOTE_Gs3, NOTE_G3, NOTE_Gs2, NOTE_Gs3, NOTE_G3, NOTE_As2, NOTE_Gs3, NOTE_C6, NOTE_C3, NOTE_C5, NOTE_C6, NOTE_C5, NOTE_As5, NOTE_As4, NOTE_C6, NOTE_C5, NOTE_As5, NOTE_As4, NOTE_Gs5, NOTE_Gs4, NOTE_G5, NOTE_G4, NOTE_As5, NOTE_As4, NOTE_Gs5, NOTE_Gs4, NOTE_G5, NOTE_G4, NOTE_F5, NOTE_F4, NOTE_Ds5, NOTE_F5, NOTE_F4, NOTE_G5, NOTE_G4, NOTE_As5, NOTE_As4, NOTE_As5, NOTE_As4, NOTE_Gs5, NOTE_Gs4, NOTE_G5, NOTE_G4, NOTE_F5, NOTE_F4, NOTE_Ds5, NOTE_Ds4, NOTE_F5, NOTE_F4, NOTE_G5, NOTE_G4, NOTE_Ds5, NOTE_Ds4, NOTE_C5, NOTE_C4, NOTE_Ds5, NOTE_Ds4, NOTE_G5, NOTE_G4, NOTE_F5, NOTE_F4, NOTE_Ds5, NOTE_Ds4, NOTE_D5, NOTE_D4, NOTE_D5, NOTE_D4, NOTE_C6, NOTE_C5, NOTE_C6, NOTE_C5, NOTE_As5, NOTE_As4, NOTE_C6, NOTE_C5, NOTE_As5, NOTE_As4, NOTE_Gs5, NOTE_Gs4, NOTE_G5, NOTE_G4, NOTE_As5, NOTE_As4, NOTE_Gs5, NOTE_Gs4, NOTE_G5, NOTE_G4, NOTE_F5, NOTE_F4, NOTE_Ds5, NOTE_Ds4, NOTE_F5, NOTE_F4, NOTE_G5, NOTE_G4, NOTE_Gs4, NOTE_Gs5, NOTE_As4, NOTE_As5, NOTE_As4, NOTE_As5, NOTE_Gs4, NOTE_Gs5, NOTE_G4, NOTE_G5, NOTE_F4, NOTE_F5, NOTE_Ds4, NOTE_Ds5, NOTE_F4, NOTE_F5, NOTE_G4, NOTE_G5, NOTE_Ds4, NOTE_Ds5, NOTE_C4, NOTE_C5, NOTE_Ds4, NOTE_Ds5, NOTE_G4, NOTE_G5, NOTE_F4, NOTE_F5, NOTE_Ds4, NOTE_Ds5, NOTE_D4, NOTE_D5, NOTE_D4, NOTE_D5, NOTE_C6, NOTE_C5, NOTE_D6, NOTE_D5, NOTE_Ds6, NOTE_Ds5, NOTE_C6, NOTE_C5, NOTE_F6, NOTE_F5, NOTE_Ds6, NOTE_Ds5, NOTE_D6, NOTE_D5, NOTE_C6, NOTE_C5, NOTE_As5, NOTE_As4, NOTE_Gs5, NOTE_Gs4, NOTE_G5, NOTE_G4, NOTE_Gs5, NOTE_Gs4, NOTE_As5, NOTE_As4, NOTE_F5, NOTE_F4, NOTE_D5, NOTE_D4, NOTE_Ds5, NOTE_Ds4, NOTE_F5, NOTE_F4, NOTE_D5, NOTE_D4, NOTE_G5, NOTE_G5, NOTE_G4, NOTE_G4, NOTE_F5, NOTE_F4, NOTE_Ds5, NOTE_Ds4, NOTE_D5, NOTE_D4, NOTE_Ds5, NOTE_Ds4, NOTE_Ds5, NOTE_Ds4, NOTE_D5, NOTE_D4, NOTE_C6, NOTE_C5, NOTE_D6, NOTE_D5, NOTE_Ds6, NOTE_Ds5, NOTE_C6, NOTE_C5, NOTE_D6, NOTE_D5, NOTE_Ds6, NOTE_Ds5, NOTE_C6, NOTE_C5, NOTE_F6, NOTE_F5, NOTE_F4, NOTE_Ds6, NOTE_Ds5, NOTE_D6, NOTE_D5, NOTE_C6, NOTE_C5, NOTE_As5, NOTE_As4, NOTE_Gs5, NOTE_Gs4, NOTE_G5, NOTE_G4, NOTE_Gs5, NOTE_Gs4, NOTE_As5, NOTE_As4, NOTE_Gs5, NOTE_Gs4, NOTE_G5, NOTE_G4, NOTE_Ds4, NOTE_Ds5, NOTE_D5, NOTE_D4, NOTE_Ds5, NOTE_Ds4, NOTE_F5, NOTE_F4, NOTE_D5, NOTE_D4, NOTE_G5, NOTE_G4, NOTE_D5, NOTE_F5, NOTE_D4, NOTE_F4, NOTE_Ds5, NOTE_Ds4, NOTE_D5, NOTE_D4, NOTE_D5, NOTE_D4, NOTE_D5, NOTE_D4, NOTE_Ds5, NOTE_Ds4, NOTE_D5, NOTE_D4, NOTE_D5, NOTE_D4, NOTE_Ds5, NOTE_Ds4, NOTE_D5, NOTE_D4, NOTE_D5, NOTE_D4, NOTE_Ds5, NOTE_Ds4, NOTE_D5, NOTE_D4, NOTE_D5, NOTE_D4, NOTE_Ds5, NOTE_Ds4, NOTE_D5, NOTE_D4, NOTE_Ds5, NOTE_Ds4, NOTE_D5, NOTE_D4, NOTE_Ds5, NOTE_Ds4, NOTE_D5, NOTE_D4, NOTE_Ds5, NOTE_Ds4, NOTE_D5, NOTE_D4, NOTE_Ds5, NOTE_Ds4, NOTE_D5, NOTE_D4, NOTE_Ds5, NOTE_Ds4, NOTE_D5, NOTE_D4, NOTE_Ds5, NOTE_Ds4, NOTE_D5, NOTE_D4, NOTE_Ds5, NOTE_Ds4, NOTE_D5, NOTE_D4, NOTE_Ds5, NOTE_Ds4, NOTE_G5, NOTE_G4, NOTE_Gs5, NOTE_Gs4, NOTE_G5, NOTE_G4, NOTE_Gs5, NOTE_Gs4, NOTE_G5, NOTE_G4, NOTE_Gs5, NOTE_Gs4, NOTE_G5, NOTE_G4, NOTE_Gs5, NOTE_Gs4, NOTE_G5, NOTE_G4, NOTE_Gs5, NOTE_Gs4, NOTE_G5, NOTE_G4, NOTE_Gs5, NOTE_Gs4, NOTE_G5, NOTE_G4, NOTE_Gs5, NOTE_Gs4, NOTE_G5, NOTE_G4, NOTE_Gs5, NOTE_Gs4, NOTE_C3, NOTE_C5, NOTE_G3, NOTE_G2, NOTE_C5, NOTE_G3, NOTE_As4, NOTE_C3, NOTE_C5, NOTE_G3, NOTE_As4, NOTE_G2, NOTE_Gs4, NOTE_G3, NOTE_G4, NOTE_Ds3, NOTE_As4, NOTE_Gs4, NOTE_G3, NOTE_G4, NOTE_F4, NOTE_As2, NOTE_Ds4, NOTE_G3, NOTE_F4, NOTE_Ds3, NOTE_G4, NOTE_G3, NOTE_As2, NOTE_G3, NOTE_As2, NOTE_As4, NOTE_F3, NOTE_F2, NOTE_As4, NOTE_F3, NOTE_Gs4, NOTE_As2, NOTE_G4, NOTE_F3, NOTE_F4, NOTE_F2, NOTE_Ds4, NOTE_F3, NOTE_F4, NOTE_Gs2, NOTE_G4, NOTE_Ds4, NOTE_Ds3, NOTE_C4, NOTE_Ds4, NOTE_F2, NOTE_G4, NOTE_Ds3, NOTE_F4, NOTE_G2, NOTE_Ds4, NOTE_D3, NOTE_D4, NOTE_G2, NOTE_D4, NOTE_D3, NOTE_As4, NOTE_C3, NOTE_C5, NOTE_G3, NOTE_G2, NOTE_C5, NOTE_G3, NOTE_As4, NOTE_C3, NOTE_C5, NOTE_G3, NOTE_As4, NOTE_G2, NOTE_Gs4, NOTE_G3, NOTE_G4, NOTE_Ds3, NOTE_As4, NOTE_Gs4, NOTE_G3, NOTE_G4, NOTE_F4, NOTE_As2, NOTE_Ds4, NOTE_G3, NOTE_F4, NOTE_Ds3, NOTE_G4, NOTE_G3, NOTE_As2, NOTE_G3, NOTE_Gs4, NOTE_As2, NOTE_As4, NOTE_F3, NOTE_F2, NOTE_As4, NOTE_F3, NOTE_Gs4, NOTE_As2, NOTE_G4, NOTE_F3, NOTE_F4, NOTE_F2, NOTE_Ds4, NOTE_F3, NOTE_F4, NOTE_Gs2, NOTE_G4, NOTE_Ds4, NOTE_Ds3, NOTE_C4, NOTE_Ds4, NOTE_F2, NOTE_G4, NOTE_Ds3, NOTE_F4, NOTE_G2, NOTE_Ds4, NOTE_D3, NOTE_D4, NOTE_G2, NOTE_D4, NOTE_D3, NOTE_Gs2, NOTE_Ds3, NOTE_C4, NOTE_D4, NOTE_Ds2, NOTE_Ds4, NOTE_Ds3, NOTE_C4, NOTE_Gs2, NOTE_F4, NOTE_Ds3, NOTE_Ds4, NOTE_Ds2, NOTE_D4, NOTE_Ds3, NOTE_C4, NOTE_As2, NOTE_As3, NOTE_F3, NOTE_Gs3, NOTE_F2, NOTE_G3, NOTE_F3, NOTE_Gs3, NOTE_As2, NOTE_As3, NOTE_F3, NOTE_F2, NOTE_F3, NOTE_F3, NOTE_Ds2, NOTE_D3, NOTE_Ds3, NOTE_As1, NOTE_F3, NOTE_D3, NOTE_G3, NOTE_G3, NOTE_Ds2, NOTE_F3, NOTE_As1, NOTE_Ds3, NOTE_D3, NOTE_Ds2, NOTE_Ds3, NOTE_As1, NOTE_Ds3, NOTE_D2, NOTE_D3, NOTE_D2, NOTE_C4, NOTE_D4, NOTE_Gs2, NOTE_Ds4, NOTE_Ds3, NOTE_C4, NOTE_D4, NOTE_Ds2, NOTE_Ds4, NOTE_Ds3, NOTE_C4, NOTE_Gs2, NOTE_F4, NOTE_Ds3, NOTE_Ds4, NOTE_Ds2, NOTE_D4, NOTE_Ds3, NOTE_C4, NOTE_As2, NOTE_As3, NOTE_Gs3, NOTE_G3, NOTE_F3, NOTE_Gs3, NOTE_As3, NOTE_F2, NOTE_F3, NOTE_Gs3, NOTE_G3, NOTE_As2, NOTE_F3, NOTE_Ds3, NOTE_F2, NOTE_F3, NOTE_D2, NOTE_D3, NOTE_Ds3, NOTE_D2, NOTE_F3, NOTE_D3, NOTE_D2, NOTE_G3, NOTE_D3, NOTE_F3, NOTE_D2, NOTE_Ds3, NOTE_D3, NOTE_D3, NOTE_G2, NOTE_D3, NOTE_Ds3, NOTE_D3, NOTE_G2, NOTE_D3, NOTE_Ds3, NOTE_D3, NOTE_G2, NOTE_D3, NOTE_Ds3, NOTE_D3, NOTE_G2, NOTE_D3, NOTE_Ds3, NOTE_D3, NOTE_Ds3, NOTE_D3, NOTE_G2, NOTE_Ds3, NOTE_D3, NOTE_Ds3, NOTE_D3, NOTE_G2, NOTE_Ds3, NOTE_D3, NOTE_Ds3, NOTE_D3, NOTE_G2, NOTE_Ds3, NOTE_D3, NOTE_Ds3, NOTE_D3, NOTE_G2, NOTE_Ds3, NOTE_G3, NOTE_G2, NOTE_Gs3, NOTE_G3, NOTE_G2, NOTE_Gs3, NOTE_G3, NOTE_G2, NOTE_Gs3, NOTE_G3, NOTE_G2, NOTE_Gs3, NOTE_G3, NOTE_G2, NOTE_Gs3, NOTE_G3, NOTE_G2, NOTE_Gs3, NOTE_G3, NOTE_Gs2, NOTE_Gs3, NOTE_G3, NOTE_As2, NOTE_Gs3, NOTE_C3, NOTE_C5, NOTE_G3, NOTE_G2, NOTE_C5, NOTE_G3, NOTE_As4, NOTE_C3, NOTE_C5, NOTE_G3, NOTE_As4, NOTE_G2, NOTE_Gs4, NOTE_G3, NOTE_G4, NOTE_Ds3, NOTE_As4, NOTE_Gs4, NOTE_G3, NOTE_G4, NOTE_F4, NOTE_As2, NOTE_Ds4, NOTE_G3, NOTE_F4, NOTE_Ds3, NOTE_G4, NOTE_G3, NOTE_As2, NOTE_G3, NOTE_As2, NOTE_As4, NOTE_F3, NOTE_F2, NOTE_As4, NOTE_F3, NOTE_Gs4, NOTE_As2, NOTE_G4, NOTE_F3, NOTE_F4, NOTE_F2, NOTE_Ds4, NOTE_F3, NOTE_F4, NOTE_Gs2, NOTE_G4, NOTE_Ds4, NOTE_Ds3, NOTE_C4, NOTE_Ds4, NOTE_F2, NOTE_G4, NOTE_Ds3, NOTE_F4, NOTE_G2, NOTE_Ds4, NOTE_D3, NOTE_D4, NOTE_G2, NOTE_D4, NOTE_D3, NOTE_As4, NOTE_C3, NOTE_C5, NOTE_G3, NOTE_G2, NOTE_C5, NOTE_G3, NOTE_As4, NOTE_C3, NOTE_C5, NOTE_G3, NOTE_As4, NOTE_G2, NOTE_Gs4, NOTE_G3, NOTE_G4, NOTE_Ds3, NOTE_As4, NOTE_Gs4, NOTE_G3, NOTE_G4, NOTE_F4, NOTE_As2, NOTE_Ds4, NOTE_G3, NOTE_F4, NOTE_Ds3, NOTE_G4, NOTE_G3, NOTE_As2, NOTE_G3, NOTE_Gs4, NOTE_As2, NOTE_As4, NOTE_F3, NOTE_F2, NOTE_As4, NOTE_F3, NOTE_Gs4, NOTE_As2, NOTE_G4, NOTE_F3, NOTE_F4, NOTE_F2, NOTE_Ds4, NOTE_F3, NOTE_F4, NOTE_Gs2, NOTE_G4, NOTE_Ds4, NOTE_Ds3, NOTE_C4, NOTE_Ds4, NOTE_F2, NOTE_G4, NOTE_Ds3, NOTE_F4, NOTE_G2, NOTE_Ds4, NOTE_D3, NOTE_D4, NOTE_G2, NOTE_D4, NOTE_D3, NOTE_Gs2, NOTE_Ds3, NOTE_C4, NOTE_D4, NOTE_Ds2, NOTE_Ds4, NOTE_Ds3, NOTE_C4, NOTE_Gs2, NOTE_F4, NOTE_Ds3, NOTE_Ds4, NOTE_Ds2, NOTE_D4, NOTE_Ds3, NOTE_C4, NOTE_As2, NOTE_As3, NOTE_F3, NOTE_Gs3, NOTE_F2, NOTE_G3, NOTE_F3, NOTE_Gs3, NOTE_As2, NOTE_As3, NOTE_F3, NOTE_F2, NOTE_F3, NOTE_F3, NOTE_Ds2, NOTE_D3, NOTE_Ds3, NOTE_As1, NOTE_F3, NOTE_D3, NOTE_G3, NOTE_G3, NOTE_Ds2, NOTE_F3, NOTE_As1, NOTE_Ds3, NOTE_D3, NOTE_Ds2, NOTE_Ds3, NOTE_As1, NOTE_Ds3, NOTE_D2, NOTE_D3, NOTE_D2, NOTE_C4, NOTE_D4, NOTE_Gs2, NOTE_Ds4, NOTE_Ds3, NOTE_C4, NOTE_D4, NOTE_Ds2, NOTE_Ds4, NOTE_Ds3, NOTE_C4, NOTE_Gs2, NOTE_F4, NOTE_Ds3, NOTE_Ds4, NOTE_Ds2, NOTE_D4, NOTE_Ds3, NOTE_C4, NOTE_As2, NOTE_As3, NOTE_Gs3, NOTE_G3, NOTE_F3, NOTE_Gs3, NOTE_As3, NOTE_F2, NOTE_F3, NOTE_Gs3, NOTE_G3, NOTE_As2, NOTE_F3, NOTE_Ds3, NOTE_F2, NOTE_F3, NOTE_D2, NOTE_D3, NOTE_Ds3, NOTE_D2, NOTE_F3, NOTE_D3, NOTE_D2, NOTE_G3, NOTE_D3, NOTE_F3, NOTE_D2, NOTE_Ds3, NOTE_D3, NOTE_D3, NOTE_G2, NOTE_D3, NOTE_Ds3, NOTE_D3, NOTE_G2, NOTE_D3, NOTE_Ds3, NOTE_D3, NOTE_G2, NOTE_D3, NOTE_Ds3, NOTE_D3, NOTE_G2, NOTE_D3, NOTE_Ds3, NOTE_D3, NOTE_Ds3, NOTE_D3, NOTE_G2, NOTE_Ds3, NOTE_D3, NOTE_Ds3, NOTE_D3, NOTE_G2, NOTE_Ds3, NOTE_D3, NOTE_Ds3, NOTE_D3, NOTE_G2, NOTE_Ds3, NOTE_D3, NOTE_Ds3, NOTE_D3, NOTE_G2, NOTE_Ds3, NOTE_G3, NOTE_G2, NOTE_Gs3, NOTE_G3, NOTE_G2, NOTE_Gs3, NOTE_G3, NOTE_G2, NOTE_Gs3, NOTE_G3, NOTE_G2, NOTE_Gs3, NOTE_G3, NOTE_G2, NOTE_Gs3, NOTE_G3, NOTE_G2, NOTE_Gs3, NOTE_G3, NOTE_Gs2, NOTE_Gs3, NOTE_G3, NOTE_As2, NOTE_Gs3, NOTE_C6, NOTE_C3, NOTE_C5, NOTE_C6, NOTE_C5, NOTE_As5, NOTE_As4, NOTE_C6, NOTE_C5, NOTE_As5, NOTE_As4, NOTE_Gs5, NOTE_Gs4, NOTE_G5, NOTE_G4, NOTE_As5, NOTE_As4, NOTE_Gs5, NOTE_Gs4, NOTE_G5, NOTE_G4, NOTE_F5, NOTE_F4, NOTE_Ds5, NOTE_F5, NOTE_F4, NOTE_G5, NOTE_G4, NOTE_As5, NOTE_As4, NOTE_As5, NOTE_As4, NOTE_Gs5, NOTE_Gs4, NOTE_G5, NOTE_G4, NOTE_F5, NOTE_F4, NOTE_Ds5, NOTE_Ds4, NOTE_F5, NOTE_F4, NOTE_G5, NOTE_G4, NOTE_Ds5, NOTE_Ds4, NOTE_C5, NOTE_C4, NOTE_Ds5, NOTE_Ds4, NOTE_G5, NOTE_G4, NOTE_F5, NOTE_F4, NOTE_Ds5, NOTE_Ds4, NOTE_D5, NOTE_D4, NOTE_D5, NOTE_D4, NOTE_C6, NOTE_C5, NOTE_C6, NOTE_C5, NOTE_As5, NOTE_As4, NOTE_C6, NOTE_C5, NOTE_As5, NOTE_As4, NOTE_Gs5, NOTE_Gs4, NOTE_G5, NOTE_G4, NOTE_As5, NOTE_As4, NOTE_Gs5, NOTE_Gs4, NOTE_G5, NOTE_G4, NOTE_F5, NOTE_F4, NOTE_Ds5, NOTE_Ds4, NOTE_F5, NOTE_F4, NOTE_G5, NOTE_G4, NOTE_Gs4, NOTE_Gs5, NOTE_As4, NOTE_As5, NOTE_As4, NOTE_As5, NOTE_Gs4, NOTE_Gs5, NOTE_G4, NOTE_G5, NOTE_F4, NOTE_F5, NOTE_Ds4, NOTE_Ds5, NOTE_F4, NOTE_F5, NOTE_G4, NOTE_G5, NOTE_Ds4, NOTE_Ds5, NOTE_C4, NOTE_C5, NOTE_Ds4, NOTE_Ds5, NOTE_G4, NOTE_G5, NOTE_F4, NOTE_F5, NOTE_Ds4, NOTE_Ds5, NOTE_D4, NOTE_D5, NOTE_D4, NOTE_D5, NOTE_C6, NOTE_C5, NOTE_D6, NOTE_D5, NOTE_Ds6, NOTE_Ds5, NOTE_C6, NOTE_C5, NOTE_F6, NOTE_F5, NOTE_Ds6, NOTE_Ds5, NOTE_D6, NOTE_D5, NOTE_C6, NOTE_C5, NOTE_As5, NOTE_As4, NOTE_Gs5, NOTE_Gs4, NOTE_G5, NOTE_G4, NOTE_Gs5, NOTE_Gs4, NOTE_As5, NOTE_As4, NOTE_F5, NOTE_F4, NOTE_D5, NOTE_D4, NOTE_Ds5, NOTE_Ds4, NOTE_F5, NOTE_F4, NOTE_D5, NOTE_D4, NOTE_G5, NOTE_G5, NOTE_G4, NOTE_G4, NOTE_F5, NOTE_F4, NOTE_Ds5, NOTE_Ds4, NOTE_D5, NOTE_D4, NOTE_Ds5, NOTE_Ds4, NOTE_Ds5, NOTE_Ds4, NOTE_D5, NOTE_D4, NOTE_C6, NOTE_C5, NOTE_D6, NOTE_D5, NOTE_Ds6, NOTE_Ds5, NOTE_C6, NOTE_C5, NOTE_D6, NOTE_D5, NOTE_Ds6, NOTE_Ds5, NOTE_C6, NOTE_C5, NOTE_F6, NOTE_F5, NOTE_F4, NOTE_Ds6, NOTE_Ds5, NOTE_D6, NOTE_D5, NOTE_C6, NOTE_C5, NOTE_As5, NOTE_As4, NOTE_Gs5, NOTE_Gs4, NOTE_G5, NOTE_G4, NOTE_Gs5, NOTE_Gs4, NOTE_As5, NOTE_As4, NOTE_Gs5, NOTE_Gs4, NOTE_G5, NOTE_G4, NOTE_Ds4, NOTE_Ds5, NOTE_D5, NOTE_D4, NOTE_Ds5, NOTE_Ds4, NOTE_F5, NOTE_F4, NOTE_D5, NOTE_D4, NOTE_G5, NOTE_G4, NOTE_D5, NOTE_F5, NOTE_D4, NOTE_F4, NOTE_Ds5, NOTE_Ds4, NOTE_D5, NOTE_D4, NOTE_D5, NOTE_D4, NOTE_D5, NOTE_D4, NOTE_Ds5, NOTE_Ds4, NOTE_D5, NOTE_D4, NOTE_D5, NOTE_D4, NOTE_Ds5, NOTE_Ds4, NOTE_D5, NOTE_D4, NOTE_D5, NOTE_D4, NOTE_Ds5, NOTE_Ds4, NOTE_D5, NOTE_D4, NOTE_D5, NOTE_D4, NOTE_Ds5, NOTE_Ds4, NOTE_D5, NOTE_D4, NOTE_Ds5, NOTE_Ds4, NOTE_D5, NOTE_D4, NOTE_Ds5, NOTE_Ds4, NOTE_D5, NOTE_D4, NOTE_Ds5, NOTE_Ds4, NOTE_D5, NOTE_D4, NOTE_Ds5, NOTE_Ds4, NOTE_D5, NOTE_D4, NOTE_Ds5, NOTE_Ds4, NOTE_D5, NOTE_D4, NOTE_Ds5, NOTE_Ds4, NOTE_D5, NOTE_D4, NOTE_Ds5, NOTE_Ds4, NOTE_D5, NOTE_D4, NOTE_Ds5, NOTE_Ds4, NOTE_G5, NOTE_G4, NOTE_Gs5, NOTE_Gs4, NOTE_G5, NOTE_G4, NOTE_Gs5, NOTE_Gs4, NOTE_G5, NOTE_G4, NOTE_Gs5, NOTE_Gs4, NOTE_G5, NOTE_G4, NOTE_Gs5, NOTE_Gs4, NOTE_G5, NOTE_G4, NOTE_Gs5, NOTE_Gs4, NOTE_G5, NOTE_G4, NOTE_Gs5, NOTE_Gs4, NOTE_G5, NOTE_G4, NOTE_Gs5, NOTE_Gs4, NOTE_G5, NOTE_G4, NOTE_Gs5, NOTE_Gs4, NOTE_C3, NOTE_C5, NOTE_G3, NOTE_G2, NOTE_C5, NOTE_G3, NOTE_As4, NOTE_C3, NOTE_C5, NOTE_G3, NOTE_As4, NOTE_G2, NOTE_Gs4, NOTE_G3, NOTE_G4, NOTE_Ds3, NOTE_As4, NOTE_Gs4, NOTE_G3, NOTE_G4, NOTE_F4, NOTE_As2, NOTE_Ds4, NOTE_G3, NOTE_F4, NOTE_Ds3, NOTE_G4, NOTE_G3, NOTE_As2, NOTE_G3, NOTE_As2, NOTE_As4, NOTE_F3, NOTE_F2, NOTE_As4, NOTE_F3, NOTE_Gs4, NOTE_As2, NOTE_G4, NOTE_F3, NOTE_F4, NOTE_F2, NOTE_Ds4, NOTE_F3, NOTE_F4, NOTE_Gs2, NOTE_G4, NOTE_Ds4, NOTE_Ds3, NOTE_C4, NOTE_Ds4, NOTE_F2, NOTE_G4, NOTE_Ds3, NOTE_F4, NOTE_G2, NOTE_Ds4, NOTE_D3, NOTE_D4, NOTE_G2, NOTE_D4, NOTE_D3, NOTE_As4, NOTE_C3, NOTE_C5, NOTE_G3, NOTE_G2, NOTE_C5, NOTE_G3, NOTE_As4, NOTE_C3, NOTE_C5, NOTE_G3, NOTE_As4, NOTE_G2, NOTE_Gs4, NOTE_G3, NOTE_G4, NOTE_Ds3, NOTE_As4, NOTE_Gs4, NOTE_G3, NOTE_G4, NOTE_F4, NOTE_As2, NOTE_Ds4, NOTE_G3, NOTE_F4, NOTE_Ds3, NOTE_G4, NOTE_G3, NOTE_As2, NOTE_G3, NOTE_Gs4, NOTE_As2, NOTE_As4, NOTE_F3, NOTE_F2, NOTE_As4, NOTE_F3, NOTE_Gs4, NOTE_As2, NOTE_G4, NOTE_F3, NOTE_F4, NOTE_F2, NOTE_Ds4, NOTE_F3, NOTE_F4, NOTE_Gs2, NOTE_G4, NOTE_Ds4, NOTE_Ds3, NOTE_C4, NOTE_Ds4, NOTE_F2, NOTE_G4, NOTE_Ds3, NOTE_F4, NOTE_G2, NOTE_Ds4, NOTE_D3, NOTE_D4, NOTE_G2, NOTE_D4, NOTE_D3, NOTE_Gs2, NOTE_Ds3, NOTE_C4, NOTE_D4, NOTE_Ds2, NOTE_Ds4, NOTE_Ds3, NOTE_C4, NOTE_Gs2, NOTE_F4, NOTE_Ds3, NOTE_Ds4, NOTE_Ds2, NOTE_D4, NOTE_Ds3, NOTE_C4, NOTE_As2, NOTE_As3, NOTE_F3, NOTE_Gs3, NOTE_F2, NOTE_G3, NOTE_F3, NOTE_Gs3, NOTE_As2, NOTE_As3, NOTE_F3, NOTE_F2, NOTE_F3, NOTE_F3, NOTE_Ds2, NOTE_D3, NOTE_Ds3, NOTE_As1, NOTE_F3, NOTE_D3, NOTE_G3, NOTE_G3, NOTE_Ds2, NOTE_F3, NOTE_As1, NOTE_Ds3, NOTE_D3, NOTE_Ds2, NOTE_Ds3, NOTE_As1, NOTE_Ds3, NOTE_D2, NOTE_D3, NOTE_D2, NOTE_C4, NOTE_D4, NOTE_Gs2, NOTE_Ds4, NOTE_Ds3, NOTE_C4, NOTE_D4, NOTE_Ds2, NOTE_Ds4, NOTE_Ds3, NOTE_C4, NOTE_Gs2, NOTE_F4, NOTE_Ds3, NOTE_Ds4, NOTE_Ds2, NOTE_D4, NOTE_Ds3, NOTE_C4, NOTE_As2, NOTE_As3, NOTE_Gs3, NOTE_G3, NOTE_F3, NOTE_Gs3, NOTE_As3, NOTE_F2, NOTE_F3, NOTE_Gs3, NOTE_G3, NOTE_As2, NOTE_F3, NOTE_Ds3, NOTE_F2, NOTE_F3, NOTE_D2, NOTE_D3, NOTE_Ds3, NOTE_D2, NOTE_F3, NOTE_D3, NOTE_D2, NOTE_G3, NOTE_D3, NOTE_F3, NOTE_D2, NOTE_Ds3, NOTE_D3, NOTE_D3, NOTE_G2, NOTE_D3, NOTE_Ds3, NOTE_D3, NOTE_G2, NOTE_D3, NOTE_Ds3, NOTE_D3, NOTE_G2, NOTE_D3, NOTE_Ds3, NOTE_D3, NOTE_G2, NOTE_D3, NOTE_Ds3, NOTE_D3, NOTE_Ds3, NOTE_D3, NOTE_G2, NOTE_Ds3, NOTE_D3, NOTE_Ds3, NOTE_D3, NOTE_G2, NOTE_Ds3, NOTE_D3, NOTE_Ds3, NOTE_D3, NOTE_G2, NOTE_Ds3, NOTE_D3, NOTE_Ds3, NOTE_D3, NOTE_G2, NOTE_Ds3, NOTE_G3, NOTE_G2, NOTE_Gs3, NOTE_G3, NOTE_G2, NOTE_Gs3, NOTE_G3, NOTE_G2, NOTE_Gs3, NOTE_G3, NOTE_G2, NOTE_Gs3, NOTE_G3, NOTE_G2, NOTE_Gs3, NOTE_G3, NOTE_G2, NOTE_Gs3, NOTE_G3, NOTE_Gs2, NOTE_Gs3, NOTE_G3, NOTE_As2, NOTE_Gs3 };
int durationsMs[] = { 97, 97, 97, 97, 97, 97, 97, 97, 97, 97, 97, 97, 97,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 97, 97 };
bool playing = false;
bool paused = false;
bool stopped = false;
size_t currentNote = 0;
unsigned long noteStartTime = 0;
int buzzerVolume = 255;
int noteDuration = 0;

void startNote(size_t i) {
  int freq = melody[i];
  noteDuration = durationsMs[i];
  if (noteDuration > 2000) noteDuration = 2000;
  if (freq == NOTE_REST) {
    ledcWriteTone(BUZZER_PIN, 0);
  } else {
    ledcWriteTone(BUZZER_PIN, freq);
    ledcWrite(BUZZER_PIN, buzzerVolume);
  }
  noteStartTime = millis();
}

void stopNote() {
  ledcWriteTone(BUZZER_PIN, 0);
}

void setup() {
  auto cfg = M5.config();
  M5.begin(cfg);

  ledcAttach(BUZZER_PIN, 2000, 8);

  M5.Display.clear();
  M5.Display.setTextDatum(middle_center);
  M5.Display.setTextSize(2.5);
  M5.Display.drawString("M5Songs", M5.Display.width()/2, M5.Display.height()/2 - 10);
  M5.Display.setTextSize(1);
  M5.Display.drawString("Press M5", M5.Display.width()/2, M5.Display.height()-18);
}

void loop() {
  M5.update();


  if (!playing && M5.BtnA.wasPressed()) {
    playing = true;
    paused = false;
    stopped = false;
    currentNote = 0;
    M5.Display.clear();
    M5.Display.setTextSize(2);
    M5.Display.drawString("Playing", M5.Display.width()/2, M5.Display.height()/2);
    startNote(currentNote);
  }

  if (playing && M5.BtnB.wasPressed()) {
    paused = !paused;
    if (paused) {
      stopNote();
      M5.Display.clear();
      M5.Display.setTextSize(2);
      M5.Display.drawString("Paused", M5.Display.width()/2, M5.Display.height()/2);
    } else {
      noteStartTime = millis();
      M5.Display.clear();
      M5.Display.setTextSize(2);
      M5.Display.drawString("Resumed", M5.Display.width()/2, M5.Display.height()/2);
    }
    delay(300);
  }

  if (playing && M5.BtnC.wasPressed()) {
    stopped = true;
    playing = false;
    paused = false;
    stopNote();
    M5.Display.clear();
    M5.Display.setTextSize(2);
    M5.Display.drawString("Stopped", M5.Display.width()/2, M5.Display.height()/2);
    delay(500);
  }

  if (playing && !paused && !stopped) {
    if (millis() - noteStartTime >= noteDuration + 20) {
      stopNote();
      currentNote++;
      if (currentNote >= sizeof(melody)/sizeof(melody[0])) {
        playing = false;
        M5.Display.clear();
        M5.Display.setTextSize(2);
        M5.Display.drawString("Done", M5.Display.width()/2, M5.Display.height()/2);
      } else {
        startNote(currentNote);
      }
    }
  }
}
